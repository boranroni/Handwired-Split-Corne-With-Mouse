## boards/shields/Kconfig.defconfig
```kconfig
if SHIELD_CORNE_HW_LEFT

config ZMK_KEYBOARD_NAME
	default "Corne HW"

config ZMK_SPLIT_BLE_ROLE_CENTRAL
	default y

endif

if SHIELD_CORNE_HW_LEFT || SHIELD_CORNE_HW_RIGHT

config ZMK_SPLIT
	default y

endif
```
